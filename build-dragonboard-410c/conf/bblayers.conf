## build-dragonboard-410c/conf/bblayers.conf
```bitbake
include templates/bblayers.inc

# dragonboard-410c specific layer configuration
BBLAYERS += " \
  ${TOPDIR}/../meta-qcom \
  ${TOPDIR}/../meta-browser \
  ${TOPDIR}/../meta-openembedded/meta-gnome \
  ${TOPDIR}/../meta-webkit \
  "
```

## build-dragonboard-410c/conf/local.conf
```bitbake
include ../../gdp-src-build/conf/templates/local.inc

MACHINE = "dragonboard-410c"

QEMU_TARGETS_append = " aarch64"

DL_DIR ?= "${TOPDIR}/../../downloads"

ACCEPT_EULA_dragonboard-410c = "1"

PNBLACKLIST[chromium] = ""
CHROMIUM_BUILD_TYPE = "Release"
CHROMIUM_EXTRA_ARGS = "--use-gl=egl --start-fullscreen --kiosk --no-first-run --no-sandbox --disable-infobars --disable-session-crashed-bubble --overscroll-history-navigation=0"

PACKAGECONFIG_pn-gstreamer1.0-plugins-bad = "faad"

IMAGE_INSTALL_append = " \
    openssh \
    gstreamer1.0-plugins-base \
    gstreamer1.0-plugins-good \
    gstreamer1.0-plugins-bad \
    expat \
    gnutls \
    json-c \
    chromium \
    connman-client \
    e2fsprogs-resize2fs \
    "
```

## build-intel/conf/bblayers.conf
```bitbake
include ../../gdp-src-build/conf/templates/bblayers.inc

# intel specific layer configuration
BBLAYERS += " \
  ${TOPDIR}/../meta-genivi-dev/meta-intel-gdp \
  ${TOPDIR}/../meta-intel \
  ${TOPDIR}/../meta-browser \
  ${TOPDIR}/../meta-openembedded/meta-gnome \
  "
```

## build-intel/conf/local.conf
```bitbake
include ../../gdp-src-build/conf/templates/local.inc

MACHINE = "intel-corei7-64"
MULTI_PROVIDER_WHITELIST += "virtual/libgl virtual/egl virtual/libgles1 virtual/libgles2"
PREFERRED_PROVIDER_virtual/libgles1 = ""
PREFERRED_PROVIDER_virtual/libgles2 = "gles-user-module"
PREFERRED_PROVIDER_virtual/egl = "libegl"
PREFERRED_PROVIDER_virtual/libgl = ""
PREFERRED_PROVIDER_virtual/mesa = ""
PREFERRED_PROVIDER_libgbm = "libgbm"
PREFERRED_PROVIDER_libgbm-dev = "libgbm"
SDKIMAGE_FEATURES_append = " staticdev-pkgs"
IMAGE_INSTALL_append = " mesa-megadriver"

DL_DIR ?= "${TOPDIR}/../../downloads"

PNBLACKLIST[chromium] = ""
CHROMIUM_BUILD_TYPE = "Release"
CHROMIUM_EXTRA_ARGS = "--use-gl=egl --start-fullscreen --kiosk --no-first-run --no-sandbox --disable-infobars --disable-session-crashed-bubble"
CHROMIUM_WAYLAND_DEPENDS_append = " glib-2.0"

PACKAGECONFIG_pn-gstreamer1.0-plugins-bad = "faad"

IMAGE_INSTALL_append = " \
    openssh \
    gstreamer1.0-plugins-base \
    gstreamer1.0-plugins-good \
    gstreamer1.0-plugins-bad \
    expat \
    gnutls \
    json-c \
    chromium \
    connman-client \
    e2fsprogs-resize2fs \
    "
```
